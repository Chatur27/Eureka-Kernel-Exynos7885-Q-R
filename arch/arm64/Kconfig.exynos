## arch/arm64/Kconfig.exynos
```kconfig
config MACH_EXYNOS7885_A10_OPEN
	bool "Build Dtbo image for SM-A105"
	depends on SOC_EXYNOS7885
	default n
	help
	Say Y here if you want to enable building dtbo for Galaxy A10.
```
